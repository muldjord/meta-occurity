## conf/layer.conf
```bitbake
# We have a conf and classes directory, add to BBPATH                                                                      
BBPATH .= ":${LAYERDIR}"

# We have recipes-* directories, add to BBFILES                                                                            
BBFILES += "${LAYERDIR}/recipes-*/*/*.bb \                                                                                 
            ${LAYERDIR}/recipes-*/*/*.bbappend"

BBFILE_COLLECTIONS += "meta-occurity"
BBFILE_PATTERN_meta-occurity = "^${LAYERDIR}/"
BBFILE_PRIORITY_meta-occurity = "8"

LAYERVERSION_meta-occurity = "1"
LAYERDEPENDS_meta-occurity = "core qt6-layer"
LAYERSERIES_COMPAT_meta-occurity = "scarthgap"
```

## conf/local.conf
```bitbake
# We have a conf and classes directory, add to BBPATH
BBPATH .= ":${LAYERDIR}"

# We have recipes-* directories, add to BBFILES
BBFILES += "${LAYERDIR}/recipes-*/*/*.bb \
            ${LAYERDIR}/recipes-*/*/*.bbappend"

BBFILE_COLLECTIONS += "meta-occurity"
BBFILE_PATTERN_meta-occurity = "^${LAYERDIR}/"
BBFILE_PRIORITY_meta-occurity = "6"

LAYERDEPENDS_meta-occurity = "core"
LAYERSERIES_COMPAT_meta-occurity = "nanbield"
```
